## config/west.yml
```yaml
manifest:
  remotes:
    - name: luberry
      url-base: https://github.com/luberry
  projects:
    - name: zmk
      remote: luberry
      revision: macros
      import: app/west.yml
  self:
    path: config
```
